/*
* SPI.c
*
* Created: 25.04.2017 22:41:59
*  Author: Farin
*/
#include <avr/io.h>
#include <stdint.h>
#include <SPI.h>
//////////////////////////////////////////////////////////////////////////
// Routine to initialize the SPI-Interface to the RFM75-Module
//////////////////////////////////////////////////////////////////////////
void SPI_init(void)
{	
	//TODO: Include chip select not pin of RFM75; So far it's configured as input!!!! Change before use!!
	DDRB = ((1<<DDB5)|(1<<DDB4)|(1<<DDB3)); //spi pins on port b MOSI SCK,SS outputs
	SPCR0 = ((1<<SPE)|(1<<MSTR)|(1<<SPR0)|(1<<CPOL)|(1<<CPHA));  // SPI enable, Master, f/16
}
//////////////////////////////////////////////////////////////////////////
// Routine to send 1 char over SPI
//////////////////////////////////////////////////////////////////////////
char SPI_Transceive(char cData)
{
	SPSR0 = cData;
	while(!(SPSR0 & (1<<SPIF)));
	return SPDR0;
}
//////////////////////////////////////////////////////////////////////////
// reads data from the spi-interface receive-buffer
//////////////////////////////////////////////////////////////////////////
uint8_t SPI_Read(uint8_t data)
{
	SPSR0 = data;
	//Wait until transfer is completed
	while(!(SPSR0 & (1<<SPIF)));
	//Maybe for a single read this isn't necessary..?
	//Return received data from the data register
	return SPDR0;
}
//////////////////////////////////////////////////////////////////////////
// Writes data to the spi-interface
//////////////////////////////////////////////////////////////////////////
void SPI_Write(uint8_t data)
{
	SPSR0 = data;
	while(!(SPSR0 & (1<<SPIF)));
}
//////////////////////////////////////////////////////////////////////////
// Writes the data to the spi-interface send-buffer
//////////////////////////////////////////////////////////////////////////
void SPI_WriteBuffer(uint8_t *data, uint8_t length)
{
	SPSR0 = data;
}